## build/conf/bblayers.conf
```bitbake
# POKY_BBLAYERS_CONF_VERSION is increased each time build/conf/bblayers.conf
# changes incompatibly
POKY_BBLAYERS_CONF_VERSION = "2"

BBPATH = "${TOPDIR}"
BBFILES ?= ""

BBLAYERS ?= " \
  /home/tata/yocto/poky/meta \
  /home/tata/yocto/poky/meta-poky \
  /home/tata/yocto/poky/meta-custom \
  /home/tata/yocto/poky/meta-yocto-bsp \
  /home/tata/yocto/meta-raspberrypi \
  "
```
